## sdkconfig.defaults
```kconfig
# 目标芯片：ESP32-C3
CONFIG_IDF_TARGET="esp32c3"

# Flash 与优化：4MB Flash，按体积优化
CONFIG_ESPTOOLPY_FLASHSIZE_4MB=y
CONFIG_COMPILER_OPTIMIZATION_SIZE=y

# 关闭蓝牙，节省 Flash 与内存（ESP32-C3 蓝牙可关闭）
CONFIG_BT_ENABLED=n

# 说明：ESP32-C3 的 Wi-Fi 为芯片内建功能，CONFIG_ESP_WIFI_ENABLED 是隐藏符号，
# 无法通过 sdkconfig 关闭；未调用 Wi-Fi API 时链接器 --gc-sections 会自动丢弃其代码，
# 配合 CONFIG_COMPILER_OPTIMIZATION_SIZE 即可保证镜像体积最小。

# 主任务与 FreeRTOS 配置
CONFIG_ESP_MAIN_TASK_STACK_SIZE=4096
CONFIG_FREERTOS_HZ=1000

# 日志级别
CONFIG_LOG_DEFAULT_LEVEL_INFO=y
```
